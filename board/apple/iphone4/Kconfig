## board/apple/iphone4/Kconfig
```kconfig
if TARGET_S5L8930

config SYS_BOARD
	default "iphone4"

config SYS_VENDOR
	default "apple"

config SYS_SOC
	default "s5l8930"

config SYS_CONFIG_NAME
	default "iphone4"

endif
```

## configs/iphone4_defconfig
```kconfig
CONFIG_ARM=y
CONFIG_TARGET_S5L8930=y
CONFIG_S5L=y
CONFIG_SYS_TEXT_BASE=0x61000000
CONFIG_ENV_SIZE=0x2000
CONFIG_NR_DRAM_BANKS=1
CONFIG_SYS_EXTRA_OPTIONS="SYS_SDRAM_SIZE=0x20000000,ARMV7_NONSEC"
# CONFIG_AUTOBOOT is not set
# CONFIG_MMC is not set
CONFIG_OF_LIBFDT=y
```
